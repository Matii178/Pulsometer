## STM32_HeartRateMeter_Zephyr/build/Kconfig/Kconfig.modules
```kconfig
menu "example-application (/home/mateusz/my-workspace/example-application)"
osource "/home/mateusz/my-workspace/example-application/Kconfig"
config ZEPHYR_EXAMPLE_APPLICATION_MODULE
	bool
	default y
endmenu
menu "cmsis (/home/mateusz/my-workspace/modules/hal/cmsis)"
osource "$(ZEPHYR_CMSIS_KCONFIG)"
config ZEPHYR_CMSIS_MODULE
	bool
	default y
endmenu
menu "hal_nordic (/home/mateusz/my-workspace/modules/hal/nordic)"
osource "$(ZEPHYR_HAL_NORDIC_KCONFIG)"
config ZEPHYR_HAL_NORDIC_MODULE
	bool
	default y
endmenu
config ZEPHYR_STM32_MODULE
   bool
   default y
```

## STM32_HeartRateMeter_Zephyr/build/Kconfig/Kconfig.shield.defconfig
```kconfig
osource "/home/mateusz/my-workspace/example-application/boards/shields/*/Kconfig.defconfig"
```

## STM32_HeartRateMeter_Zephyr/build/Kconfig/arch/Kconfig
```kconfig
# Load arch Kconfig descriptions.
osource "/home/mateusz/my-workspace/zephyr/arch/x86/Kconfig"
osource "/home/mateusz/my-workspace/zephyr/arch/xtensa/Kconfig"
osource "/home/mateusz/my-workspace/zephyr/arch/sparc/Kconfig"
osource "/home/mateusz/my-workspace/zephyr/arch/riscv/Kconfig"
osource "/home/mateusz/my-workspace/zephyr/arch/posix/Kconfig"
osource "/home/mateusz/my-workspace/zephyr/arch/nios2/Kconfig"
osource "/home/mateusz/my-workspace/zephyr/arch/mips/Kconfig"
osource "/home/mateusz/my-workspace/zephyr/arch/arm64/Kconfig"
osource "/home/mateusz/my-workspace/zephyr/arch/arm/Kconfig"
osource "/home/mateusz/my-workspace/zephyr/arch/arc/Kconfig"
```
